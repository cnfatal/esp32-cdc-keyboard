## main/Kconfig.projbuild
```kconfig
menu "USB Configuration"
    menu "Descriptor configuration"

        config DESC_HID_STRING
            string "HID Device String"
            default "Gaming Mouse HID Device"
            help
                Name of the HID device.

    endmenu
endmenu
```

## sdkconfig.defaults
```kconfig
CONFIG_IDF_TARGET="esp32s3"

CONFIG_TINYUSB_DESC_CUSTOM_VID=0x46d
CONFIG_TINYUSB_DESC_CUSTOM_PID=0xc07f

CONFIG_TINYUSB_DESC_MANUFACTURER_STRING="Logitech"
CONFIG_TINYUSB_DESC_PRODUCT_STRING="Gaming Mouse G403"
CONFIG_TINYUSB_DESC_SERIAL_STRING="498230883438"
CONFIG_TINYUSB_DESC_CDC_STRING="Gaming Mouse RGB"

CONFIG_TINYUSB_CDC_ENABLED=y
CONFIG_TINYUSB_CDC_COUNT=1

CONFIG_TINYUSB_HID_COUNT=2
```
